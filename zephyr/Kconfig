## zephyr/Kconfig
```kconfig
config LIB_BOOST_SML
    bool "Enable use of the stateforward::sml C++ state machine library"
    default n
    depends on CPP && !STD_CPP98 && !STD_CPP11 && !STD_CPP14
    help
      Include the stateforward::sml state machine language library,
      see https://github.com/stateforward/sml.cpp.
```
